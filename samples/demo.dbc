VERSION ""

NS_ :

BS_:

BU_: ECU Gateway

BO_ 256 EngineData: 8 ECU
 SG_ EngineSpeed : 0|16@1+ (0.25,0) [0|8031.875] "rpm" ECU
 SG_ ThrottlePos : 16|8@1+ (0.392157,0) [0|100] "%" ECU

BO_ 512 VehicleStatus: 8 Gateway
 SG_ VehicleSpeed : 0|16@1+ (0.01,0) [0|655.35] "km/h" Gateway

CM_ SG_ 256 EngineSpeed "发动机转速";
CM_ SG_ 256 ThrottlePos "节气门开度";
CM_ SG_ 512 VehicleSpeed "车速";
CM_ BO_ 256 "发动机数据";
CM_ BO_ 512 "整车状态";
BA_DEF_ BO_  "GenMsgCycleTime" INT 0 65535;
BA_DEF_DEF_  "GenMsgCycleTime" 0;
BA_ "GenMsgCycleTime" BO_ 256 100;
BA_ "GenMsgCycleTime" BO_ 512 200;
